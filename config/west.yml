## config/west.yml
```yaml
manifest:
  remotes:
    - name: zmkfirmware
      url-base: https://github.com/zmkfirmware
    - name: petejohanson
      url-base: https://github.com/petejohanson
    - name: crizzy9
      url-base: http://github.com/crizzy9
    - name: eyelash
      url-base: https://github.com/habibimd

  projects:
    - name: zmk
      remote: petejohanson
      revision: feat/pointers-with-input-processors
      import: app/west.yml

    - name: eyelash-corne
      remote: eyelash
      revision: main
      path: modules/eyelash-corne

  self:
    path: config
```
